## conf/layer.conf
```bitbake
# We have a conf and classes directory, add to BBPATH
BBPATH .= ":${LAYERDIR}"

# We have recipes-* directories, add to BBFILES
BBFILES += "${LAYERDIR}/recipes-*/*/*.bb \
            ${LAYERDIR}/recipes-*/*/*.bbappend"

BBFILE_COLLECTIONS += "meta-platinum"
BBFILE_PATTERN_meta-platinum = "^${LAYERDIR}/"
BBFILE_PRIORITY_meta-platinum = "6"

LAYERDEPENDS_meta-platinum = "core"
LAYERSERIES_COMPAT_meta-platinum = "honister"
```
